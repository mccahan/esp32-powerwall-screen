## sdkconfig.defaults
```kconfig
# ESP32-S3 PSRAM Configuration for RGB Panel
# Required for Guition ESP32-S3-4848S040 with 480x480 RGB display

# Enable SPIRAM (PSRAM)
CONFIG_SPIRAM=y
CONFIG_SPIRAM_MODE_OCT=y
CONFIG_SPIRAM_SPEED_80M=y

# PSRAM memory allocation settings
CONFIG_SPIRAM_BOOT_INIT=y
CONFIG_SPIRAM_USE_MALLOC=y
CONFIG_SPIRAM_MALLOC_ALWAYSINTERNAL=4096
CONFIG_SPIRAM_MALLOC_RESERVE_INTERNAL=32768

# Allow allocating DMA-capable memory from PSRAM
# Critical for RGB panel frame buffer
CONFIG_SPIRAM_TRY_ALLOCATE_WIFI_LWIP=y

# Memory protection
CONFIG_ESP32S3_DATA_CACHE_64KB=y
CONFIG_ESP32S3_DATA_CACHE_LINE_64B=y

# Increase main task stack size (helpful for complex init)
CONFIG_ESP_MAIN_TASK_STACK_SIZE=8192

# Watchdog timers - increase timeout for complex init
CONFIG_ESP_TASK_WDT_TIMEOUT_S=10

# Flash settings (DIO mode - QIO not compatible with this flash chip)
CONFIG_ESPTOOLPY_FLASHMODE_DIO=y
CONFIG_ESPTOOLPY_FLASHFREQ_80M=y

# LCD RGB Panel specific
CONFIG_LCD_RGB_ISR_IRAM_SAFE=y
```
